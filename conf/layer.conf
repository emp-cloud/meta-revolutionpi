## conf/machine/revpi.conf
```bitbake
#@TYPE: Machine
#@NAME: Revolution Pi Base Modules (RevPi Core, RevPi Connect, RevPi Flat)
#@DESCRIPTION: Reference machine configuration for https://revolutionpi.com/de/produkte/revolution-pi-serie

require conf/machine/include/arm/armv8a/tune-cortexa53.inc
include conf/machine/include/rpi-base.inc

PREFERRED_PROVIDER_virtual/kernel ??= "linux-revpi"

INIT_MANAGER = "systemd"
# journald already collects syslog and kernel messages. busybox syslogd/klogd
# would duplicate it and loop with ForwardToKMsg=yes from revpi-base-files.
VIRTUAL-RUNTIME_base-utils-syslog ?= ""

MACHINE_FEATURES += "pci"
MACHINE_EXTRA_RRECOMMENDS += "\
    linux-firmware-rpidistro-bcm43430 \
    linux-firmware-rpidistro-bcm43455 \
    linux-firmware-rpidistro-bcm43456 \
    linux-firmware-rpidistro-bcm43436 \
    linux-firmware-rpidistro-bcm43436s \
    firmware-nxp \
    bluez-firmware-rpidistro-bcm43430a1-hcd \
    bluez-firmware-rpidistro-bcm43430b0-hcd \
    bluez-firmware-rpidistro-bcm4345c0-hcd \
    bluez-firmware-rpidistro-bcm4345c5-hcd \
    revpi-base-files \
    revpi-firmware \
    picontrol \
"

RPI_KERNEL_DEVICETREE = " \
    broadcom/bcm2711-rpi-4-b.dtb \
    broadcom/bcm2711-rpi-cm4.dtb \
    broadcom/bcm2711-rpi-cm4s.dtb \
    broadcom/bcm2712-rpi-5-b.dtb \
    broadcom/bcm2712-rpi-cm5-cm5io.dtb \
"

IMAGE_BOOT_FILES:append = " hat_map.dtb;overlays/hat_map.dtb"

# Provides the pin definitions the VideoCore firmware needs to locate the HAT
# EEPROM's ID_SDA/ID_SCL pins on CM4S-based devices (eg. Flat S) before Linux
# boots. Without it, the firmware never finds the HAT EEPROM and its embedded
# devicetree overlay is never applied.
IMAGE_BOOT_FILES:append = " revpi-dt-blob.dtbo;dt-blob.bin"

RPI_KERNEL_DEVICETREE_OVERLAYS:append = " \
    overlays/hat_map.dtb \
    overlays/revpi-compact-dt-blob.dtbo \
    overlays/revpi-compact.dtbo \
    overlays/revpi-con-can.dtbo \
    overlays/revpi-connect-dt-blob.dtbo \
    overlays/revpi-connect.dtbo \
    overlays/revpi-connect-s-dt-blob.dtbo \
    overlays/revpi-connect-s.dtbo \
    overlays/revpi-connect-se-dt-blob.dtbo \
    overlays/revpi-connect-se.dtbo \
    overlays/revpi-connect4.dtbo \
    overlays/revpi-connect4-2026.dtbo \
    overlays/revpi-connect5-can-can.dtbo \
    overlays/revpi-connect5-can.dtbo \
    overlays/revpi-connect5.dtbo \
    overlays/revpi-core-2022.dtbo \
    overlays/revpi-core-cm1.dtbo \
    overlays/revpi-core-dt-blob.dtbo \
    overlays/revpi-core.dtbo \
    overlays/revpi-core-s-2022.dtbo \
    overlays/revpi-core-s-2026.dtbo \
    overlays/revpi-core-s-dt-blob.dtbo \
    overlays/revpi-core-s.dtbo \
    overlays/revpi-core-se-2022.dtbo \
    overlays/revpi-core-se-2026.dtbo \
    overlays/revpi-dt-blob.dtbo \
    overlays/revpi-flasher.dtbo \
    overlays/revpi-flat-dt-blob.dtbo \
    overlays/revpi-flat.dtbo \
    overlays/revpi-flat-s-2022-dsa.dtbo \
    overlays/revpi-flat-s-2022.dtbo \
    overlays/revpi-flat-s-2025.dtbo \
    overlays/revpi-hat-eeprom.dtbo \
    overlays/revpi-hat-eeprom-pi5.dtbo \
    "

SDIMG_KERNELIMAGE ?= "kernel8.img"
KERNEL_IMAGETYPE_UBOOT ?= "Image"
KERNEL_IMAGETYPE_DIRECT ?= "Image"
KERNEL_BOOTCMD ?= "booti"
UBOOT_MACHINE = "rpi_arm64_config"
SERIAL_CONSOLES ?= "115200;ttyS0"
```
